## conf/layer.conf
```bitbake
# We have a conf and classes directory, add to BBPATH
BBPATH .= ":${LAYERDIR}"

# We have recipes-* directories, add to BBFILES
BBFILES += "${LAYERDIR}/recipes-*/*/*.bb \
            ${LAYERDIR}/recipes-*/*/*.bbappend"

BBFILE_COLLECTIONS += "meta-rpi-personal"
BBFILE_PATTERN_meta-rpi-personal = "^${LAYERDIR}/"
BBFILE_PRIORITY_meta-rpi-personal = "6"

LAYERDEPENDS_meta-rpi-personal = "core raspberrypi"
LAYERSERIES_COMPAT_meta-rpi-personal = "wrynose"

PREFERRED_PROVIDER_virtual/kernel = "linux-raspberrypi"
PREFERRED_VERSION_linux-raspberrypi = "7.1%"
```
